## config/boards/shields/left_bbtrackball/Kconfig.shield
```kconfig
# Copyright (c) 2022 The ZMK Contributors
# SPDX-License-Identifier: MIT

config SHIELD_LEFT_BBTRACKBALL
    def_bool $(shields_list_contains,left_bbtrackball)
```

## config/boards/shields/right_trackpoint/Kconfig.shield
```kconfig
# Copyright (c) 2022 The ZMK Contributors
# SPDX-License-Identifier: MIT

config SHIELD_RIGHT_TRACKPOINT
    def_bool $(shields_list_contains,right_trackpoint)
```
